## tests/boot/with_mcumgr/testcase.yaml
```yaml
common:
  sysbuild: true
  platform_allow:
    - nrf5340dk/nrf5340/cpuapp
    - nrf54l15dk/nrf54l15/cpuapp
    - nrf9160dk/nrf9160
    - nucleo_f091rc
    - nucleo_g474re
    - nucleo_u385rg_q
    - nucleo_wl55jc
    # - b_u585i_iot02a
    # - nucleo_f746zg
    # - disco_l475_iot1
    # - nucleo_h743zi
    # - nucleo_l152re
    # - nucleo_u083rc
    # - nucleo_wb55rg
    # - nucleo_wba55cg
    # - nucleo_f429zi
    # - nucleo_f207zg
    # - stm32f3_disco@B
    # - stm32h573i_dk
    # - stm32u083c_dk
  timeout: 600
  slow: true
  tags:
    - pytest
    - mcuboot
    - mcumgr
tests:
  boot.with_mcumgr.test_upgrade:
    platform_allow:
      - nrf52840dk/nrf52840
      - stm32u083c_dk
      - nucleo_wb55rg
    integration_platforms:
      - nrf52840dk/nrf52840
    harness: pytest
    harness_config:
      pytest_root:
        - "pytest/test_upgrade.py"

  boot.with_mcumgr.test_upgrade_ble:
    platform_allow:
      - nrf52840dk/nrf52840
    platform_exclude:
      - nrf9160dk/nrf9160
      - nucleo_wba55cg
    integration_platforms:
      - nrf52840dk/nrf52840
    extra_args: EXTRA_CONF_FILE="overlay-bt.conf"
    harness: pytest
    harness_config:
      fixture: usb_hci
      pytest_root:
        - "pytest/test_upgrade_ble.py"

  boot.with_mcumgr.test_downgrade_prevention:
    platform_allow:
      - nrf52840dk/nrf52840
      - stm32u083c_dk
    integration_platforms:
      - nrf52840dk/nrf52840
    harness: pytest
    harness_config:
      pytest_root:
        - "pytest/test_downgrade_prevention.py"
    extra_args:
      - mcuboot_CONFIG_MCUBOOT_DOWNGRADE_PREVENTION=y
    extra_configs:
      - CONFIG_MCUBOOT_IMGTOOL_SIGN_VERSION="1.1.1+1"

  boot.with_mcumgr.test_upgrade.swap_using_offset:
    integration_platforms:
      - nrf5340dk/nrf5340/cpuapp
    harness: pytest
    harness_config:
      pytest_root:
        - "pytest/test_upgrade.py"
    extra_args:
      - SB_CONFIG_MCUBOOT_MODE_SWAP_USING_OFFSET=y
```
